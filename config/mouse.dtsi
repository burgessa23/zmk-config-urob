#define ZMK_POINTING_DEFAULT_MOVE_VAL 1500
#define ZMK_POINTING_DEFAULT_SCRL_VAL 10    

#include <dt-bindings/zmk/pointing.h>
#include <input/processors.dtsi>

&mmv {
  acceleration-exponent = <1>;          // 1
  time-to-max-speed-ms = <300>;         // 300
  delay-ms = <0>;                       // 0
};

&msc {
  acceleration-exponent = <0>;          // 0
  time-to-max-speed-ms = <300>;         // 300
  delay-ms = <0>;                       // 0
};

&msc_input_listener {
    input-processors = <&zip_xy_scaler 1 3>;
};

