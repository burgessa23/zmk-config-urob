#include <behaviors.dtsi>
#include <behaviors/num_word.dtsi> // requires auto-layer module
#include <dt-bindings/zmk/keys.h>
#ifdef CONFIG_WIRELESS
    #include <dt-bindings/zmk/bt.h>
    #define _BT_SEL_KEYS_ &bt BT_SEL 0 &bt BT_SEL 1 &bt BT_SEL 2 &bt BT_SEL 3 &bt BT_CLR
#else
    #define _BT_SEL_KEYS_ &trans &trans &trans &trans &trans
#endif

#include "zmk-helpers/helper.h"

#define DEF 0
#define NAV 1
#define SYM 2
#define NUM 3
#define FN 4
#define SYS 5
#define MOUSE 6

#define XXX &none
#define ___ &trans

/* Global settings */

#define QUICK_TAP_MS 175

&sk {  // sticky-key config
    release-after-ms = <900>;  // release after 0.9s
    quick-release;             // no double capitalization when rolling keys
};

&sl {  // sticky-layer config
    ignore-modifiers;          // allow chording sticky mods & layers
};

&lt {  // layer-tap config
    flavor = "balanced";
    tapping-term-ms = <200>;
    quick-tap-ms = <QUICK_TAP_MS>;
};

/* Homerow mods */

#define KEYS_L LT0 LT1 LT2 LT3 LT4 LM0 LM1 LM2 LM3 LM4 LB0 LB1 LB2 LB3 LB4 LB5  // left hand
#define KEYS_R RT0 RT1 RT2 RT3 RT4 RM0 RM1 RM2 RM3 RM4 RB0 RB1 RB2 RB3 RB4 RB5  // right hand
#ifndef LH2
    #define THUMBS LH1 LH0 RH0 RH1                                          // thumbs on 34 keys
#else
    #define THUMBS LH2 LH1 LH0 RH0 RH1 RH2                                  // thumbs on 36+ keys
#endif

#define MAKE_HRM(NAME, HOLD, TAP, TRIGGER_POS) \
    ZMK_HOLD_TAP(NAME, \
        flavor = "balanced"; \
        tapping-term-ms = <280>; \
        quick-tap-ms = <QUICK_TAP_MS>; \
        require-prior-idle-ms = <150>; \
        bindings = <HOLD>, <TAP>; \
        hold-trigger-key-positions = <TRIGGER_POS>; \
        hold-trigger-on-release; \
    )
MAKE_HRM(hml, &kp, &kp, KEYS_R THUMBS)  // left-hand HRMs
MAKE_HRM(s_hmr, &hmr_sshft, &kp, KEYS_L KEYS_R THUMBS)  // smart-shift HRMs
MAKE_HRM(hmr, &kp, &kp, KEYS_L THUMBS)  // right-hand HRMs

// HRM combo hack - workaround for lack of tap-only combos (ZMK issue #544)
#define ZMK_COMBO_8(NAME, TAP, KEYPOS, LAYERS, COMBO_TERM, COMBO_IDLE, HOLD, SIDE) \
    MAKE_HRM(hm_combo_ ## NAME, &kp, TAP, SIDE THUMBS) \
    ZMK_COMBO_6(NAME, &hm_combo_ ## NAME HOLD 0, KEYPOS, LAYERS, COMBO_TERM, COMBO_IDLE)

/* Combos, leader key sequences, mouse emulation */

#include "mouse.dtsi"
#include "extra_behaviours.dtsi"
#include "combos.dtsi"  // must be sources after HRM-combo hack
#include "leader.dtsi"





/* Nav cluster */

// long-tap action on hold, short-tap action on all interrupts
#define MT_CORE \
    flavor = "tap-preferred"; \
    tapping-term-ms = <220>; \
    quick-tap-ms = <220>; \
    hold-trigger-key-positions = <0>;

&mt { MT_CORE };
ZMK_HOLD_TAP(mt_home, bindings = <&masked_home>, <&kp>; MT_CORE)
ZMK_HOLD_TAP(mt_end, bindings = <&masked_end>, <&kp>; MT_CORE)

#define NAV_LEFT  &mt_home 0   LEFT    // tap: left  | long-tap: beginning of line
#define NAV_RIGHT &mt_end 0    RIGHT   // tap: right | long-tap: end       of line
#define NAV_UP    &mt LG(HOME) UP      // tap: up    | long-tap: beginning of document
#define NAV_DOWN  &mt LG(END)  DOWN    // tap: down  | long-tap: end       of document
#define NAV_BSPC  &mt LG(BSPC) BSPC    // tap: bspc  | long-tap: delete word backward
#define NAV_DEL   &mt LG(DEL)  DEL     // tap: del   | long-tap: delete word forward

// mask CTRL when holding left/right to avoid accidental jumps to beginning/end of document
#define MASK_MODS(NAME, MODS, BINDING) \
    ZMK_MOD_MORPH(NAME, \
        bindings = <BINDING>, <BINDING>; \
        mods = <MODS>; \
    )
MASK_MODS(masked_home, (MOD_LCTL), &kp HOME)
MASK_MODS(masked_end,  (MOD_LCTL), &kp END)

/* Caps-word, num-word and smart-mouse */

// tap: sticky-shift | shift + tap/ double-tap: caps-word | hold: shift
ZMK_MOD_MORPH(smart_shft,
    bindings = <&sk LSHFT>, <&caps_word>;
    mods = <(MOD_RSFT)>;
)

ZMK_MOD_MORPH(hmr_sshft,
    bindings = <&kp RSHFT>, <&caps_word>;
    mods = <(MOD_LSFT)>;
)

&caps_word {  // mods deactivate caps-word, requires PR #1451
    /delete-property/ ignore-modifiers;
};

&sk {
    release-after-ms = <2000>;
    quick-release;
};

// smart-mouse, requires PR #1366
ZMK_TRI_STATE(
    smart_mouse, bindings = <&tog MOUSE>, <&none>, <&tog MOUSE>;
    ignored-key-positions =
        <LT1 LT3 LM1 LM2 LM3 LM4 LH0 LH1 RT0 RT1 RT2 RT3 RT4 RM0 RM1 RM2 RM3 RM4 RB1 RB2 RB3 RH0 RH1>;
    ignored-layers = <MOUSE NAV FN>;)

/* Custom behaviors */


// reuse basic mod-morph scheme
#define SIMPLE_MORPH(NAME, MOD, BINDING1, BINDING2) \
    ZMK_MOD_MORPH(NAME, \
        mods = <(MOD_L ## MOD|MOD_R ## MOD)>; \
        bindings = <BINDING1>, <BINDING2>; \
    )

// tap: enter | hold: num-layer | shift + hold: num_word
#define SMART_NUM &smart_num NUM 0
ZMK_HOLD_TAP(smart_num,
    flavor = "balanced";
    tapping-term-ms = <250>;
    quick-tap-ms = <QUICK_TAP_MS>;
    bindings = <&mo>, <&num_morph>;
)
SIMPLE_MORPH(num_morph, SFT, &kp RET, &num_word NUM)

// tap: comma | shift + tap: semicolon | ctrl + shift + tap: <
SIMPLE_MORPH(comma_morph, SFT, &kp COMMA, &comma_inner_morph)
SIMPLE_MORPH(comma_inner_morph, CTL, &kp SEMICOLON, &kp LESS_THAN)

// tap: dot | shift + tap: colon | ctrl + shift + tap: >
SIMPLE_MORPH(dot_morph, SFT, &kp DOT, &dot_inner_morph)
SIMPLE_MORPH(dot_inner_morph, CTL, &kp COLON, &kp GREATER_THAN)

// tap: excl | shift + tap: qmark
SIMPLE_MORPH(qexcl, SFT, &kp EXCL, &kp QMARK)

// tap: left/right parenthesis | shft + tap: less-than/greater-than
SIMPLE_MORPH(lpar_lt, SFT, &kp LPAR, &kp LT)
SIMPLE_MORPH(rpar_gt, SFT, &kp RPAR, &kp GT)

// tap: space | shift + tap: dot -> space -> sticky shift | hold: activate layer
ZMK_HOLD_TAP(lt_spc,
    flavor = "balanced";
    tapping-term-ms = <200>;
    quick-tap-ms = <QUICK_TAP_MS>;
    bindings = <&mo>, <&spc_morph>;
)
SIMPLE_MORPH(spc_morph, SFT, &kp SPACE, &dot_spc)
ZMK_MACRO(dot_spc,
    wait-ms = <0>;
    tap-ms = <5>;
    bindings = <&kp DOT &kp SPACE &sk LSHFT>;
)

// tap: copy | double-tap: cut
ZMK_TAP_DANCE(copy_cut,
    tapping-term-ms = <200>;
    bindings = <&kp LG(C)>, <&kp LG(X)>;
)

ZMK_TAP_DANCE(q_esc,
    tapping-term-ms = <250>;
    bindings = <&kp Q>, <&kp ESC>;
)

// hold: autoshift R | tap: R | double-tap: browser refresh
ZMK_TAP_DANCE(r_rld,
    tapping-term-ms = <200>;
    bindings = <&as LS(R) R>, <&kp LG(R)>;
)

// hold: autoshift T | tap: T | double-tap: browser new tab
ZMK_TAP_DANCE(t_ntab,
    tapping-term-ms = <200>;
    bindings = <&as LS(T) T>, <&kp LG(T)>;
)

// hold: autoshift C | tap: C | double-tap: copy
ZMK_TAP_DANCE(c_cpy,
    tapping-term-ms = <200>;
    bindings = <&as LS(C) C>, <&kp LG(C)>;
)

// hold: autoshift V | tap: V | double-tap: paste
ZMK_TAP_DANCE(v_pst,
    tapping-term-ms = <200>;
    bindings = <&as LS(V) V>, <&kp LG(V)>;
)

// hold: autoshift R | tap: R | double-tap: browser refresh
ZMK_TAP_DANCE(paste_buff,
    tapping-term-ms = <200>;
    bindings = <&kp LG(V)>, <&kp LA(LS(C))>;
)

// hold: LGUI | tap: raycast | shift-tap: raycast copy buffer | double-tap: aerospace switcher
ZMK_HOLD_TAP(gui_ray_switch,
    flavor = "balanced";
    tapping-term-ms = <280>;
    quick-tap-ms = <QUICK_TAP_MS>;
    bindings = <&kp>, <&gui_ray_switch_dance>;
)
ZMK_TAP_DANCE(gui_ray_switch_dance,
    tapping-term-ms = <250>;
    bindings = <&ray_morph>, <&kp RG(LC(LA(A)))>;
)
SIMPLE_MORPH(ray_morph, SFT, &kp LC(SPACE), &kp LA(LS(C)))


// Sticky shift + leader
/* ZMK_MACRO(leader_sft, bindings = <&sk LSHFT &leader>;) */

// misc aliases
#define CANCEL          &kp K_CANCEL             // cancel caps-word, num-word and smart-mouse
#define DSK_PREV        &kp LS(LA(LG(LC(TAB))))  // previous desktop
#define DSK_NEXT        &hmr LGUI LA(LG(LC(TAB)))  // next     desktop
#define AS(keycode)     &as LS(keycode) keycode
#define GRID            &kp LC(LG(LA(G)))
#define HINT            &kp LC(LG(LA(H)))
#define ESC_SWITCH_COPY &esc_switch_copy RG(LC(LALT)) 0
#define GUI_RAY_SWITCH  &gui_ray_switch LGUI 0
#define LDR_FN_TAB      &ldr_fn_tab FN 0
#define Q_EXCL_SLSH     &q_excl_slsh QMARK 0
#define SYM_DEL         &lt SYM BSPC
#define HMR_J_SSHFT     &s_hmr 0 J

/* Keymap */

ZMK_CONDITIONAL_LAYER(sys, NAV NUM, SYS)  // NAV + NUM --> SYS


#ifndef ZMK_BASE_LAYER
  #define ZMK_BASE_LAYER(name, LT, RT, LM, RM, LB, RB, LH, RH)                 \
      ZMK_LAYER(name, LT RT LM RM LB RB LH RH)
#endif

ZMK_BASE_LAYER(Base,
//╭─────────────┬─────────────┬─────────────┬─────────────┬─────────────╮ ╭─────────────┬─────────────┬─────────────┬─────────────┬─────────────╮
   &q_esc        AS(W)         AS(E)          AS(R)         AS(T)       ,   AS(Y)         AS(U)         AS(I)         AS(O)         AS(P)       ,
//├─────────────┼─────────────┼─────────────┼─────────────┼─────────────┤ ├─────────────┼─────────────┼─────────────┼─────────────┼─────────────┤
   &hml LGUI A   &hml LALT S   &hml LCTRL D  &hml LSHFT F  AS(G)        ,   AS(H)         HMR_J_SSHFT   &hmr LCTRL K  &hmr LALT L  &hmr LGUI SQT,
//├─────────────┼─────────────┼─────────────┼─────────────┼─────────────┤ ├─────────────┼─────────────┼─────────────┼─────────────┼─────────────┤
   AS(Z)         AS(X)         &c_cpy        &v_pst        AS(B)        ,   AS(N)         AS(M)        &comma_morph  &dot_morph    Q_EXCL_SLSH  ,
//╰─────────────┼─────────────┴─────────────┼─────────────┼─────────────┤ ├─────────────┼─────────────┼─────────────┴───────────────────────────╯
                                             &lt_spc NAV 0 LDR_FN_TAB   ,   SYM_DEL       SMART_NUM                                              
//                                          ╰─────────────┴─────────────╯ ╰─────────────┴─────────────╯                                          
)

ZMK_BASE_LAYER(Nav,
//╭─────────────┬─────────────┬─────────────┬─────────────┬─────────────╮ ╭─────────────┬─────────────┬─────────────┬─────────────┬─────────────╮
   &kp LG(Z)       &kp LG(X)     &copy_cut    &paste_buff  &kp LS(LG(Z)),    &kp PG_DN      &kp HOME      &kp UP        &kp END       &kp PG_UP ,
//├─────────────┼─────────────┼─────────────┼─────────────┼─────────────┤ ├─────────────┼─────────────┼─────────────┼─────────────┼─────────────┤
   &kp LGUI        &kp LALT      &kp LCTRL     &kp LSHFT   &kp LG(LS(C)),    DSK_PREV       &kp LEFT      &kp DOWN      &kp RIGHT     DSK_NEXT  ,
//├─────────────┼─────────────┼─────────────┼─────────────┼─────────────┤ ├─────────────┼─────────────┼─────────────┼─────────────┼─────────────┤
   &sk LGUI        &sk LALT      &sk LCTRL     &sk LSHFT    &kp LC(TAB) ,   &kp LG(LBKT)   &u_left     &kp LS(LG(J))   &u_right    &kp LG(RBKT) ,
//╰─────────────┼─────────────┴─────────────┼─────────────┼─────────────┤ ├─────────────┼─────────────┼─────────────┴───────────────────────────╯
                                             ___           ___          ,    &swapper           ___                                              
//                                          ╰─────────────┴─────────────╯ ╰─────────────┴─────────────╯                                          
)

ZMK_BASE_LAYER(Sym,
//╭─────────────┬─────────────┬─────────────┬─────────────┬─────────────╮ ╭─────────────┬─────────────┬─────────────┬─────────────┬─────────────╮
      &kp PIPE    &kp AMPS       &kp ASTRK    &kp PIPE       &kp PRCNT  ,    &kp PG_DN      &kp HOME      &kp UP        &kp END      &kp PG_UP  , 
//├─────────────┼─────────────┼─────────────┼─────────────┼─────────────┤ ├─────────────┼─────────────┼─────────────┼─────────────┼─────────────┤
      &kp LGUI    &kp DLLR       &kp PRCNT    &kp CARET      &kp PLUS   ,    &kp LC(UP)     &kp LEFT      &kp DOWN      &kp RIGHT  &kp LC(DOWN) ,
//├─────────────┼─────────────┼─────────────┼─────────────┼─────────────┤ ├─────────────┼─────────────┼─────────────┼─────────────┼─────────────┤
      &kp LBKT     &qexcl        &kp AT       &kp HASH       &kp RBKT   ,  &kp LS(LG(Z))    &u_left       &kp LC(R)     &u_right     &kp LG(Z)  ,
//╰─────────────┼─────────────┴─────────────┼─────────────┼─────────────┤ ├─────────────┼─────────────┼─────────────┴───────────────────────────╯
                                              &kp LPAR       &kp RPAR   ,    ___           &swapper                                              
//                                          ╰─────────────┴─────────────╯ ╰─────────────┴─────────────╯                                          
)

ZMK_BASE_LAYER(Num,
//╭─────────────┬─────────────┬─────────────┬─────────────┬─────────────╮ ╭─────────────┬─────────────┬─────────────┬─────────────┬─────────────╮
   AS(BSLH)         AS(N7)       AS(N8)         AS(N9)       AS(N5)     ,    &kp MINUS        ___           ___          ___           ___      , 
//├─────────────┼─────────────┼─────────────┼─────────────┼─────────────┤ ├─────────────┼─────────────┼─────────────┼─────────────┼─────────────┤
   ___              AS(N4)       AS(N5)         AS(N6)       AS(EQUAL)  ,    &kp UNDER     &kp RSHFT    &kp LCTRL       &kp LALT    &kp LGUI    ,  
//├─────────────┼─────────────┼─────────────┼─────────────┼─────────────┤ ├─────────────┼─────────────┼─────────────┼─────────────┼─────────────┤
   AS(GRAVE)        AS(N1)       AS(N2)         AS(N3)     ___          ,    &kp PLUS          ___        ___              ___           ___    , 
//╰─────────────┼─────────────┴─────────────┼─────────────┼─────────────┤ ├─────────────┼─────────────┼─────────────┴───────────────────────────╯
                                                AS(N0)      ___         ,    ___           ___                                                     
//                                          ╰─────────────┴─────────────╯ ╰─────────────┴─────────────╯                                                
)

ZMK_BASE_LAYER(Fn,
//╭─────────────┬─────────────┬─────────────┬─────────────┬─────────────╮ ╭─────────────┬─────────────┬─────────────┬─────────────┬─────────────╮
   &kp F12       &kp F7        &kp F8        &kp F9         ___         ,   &kp F15       &kp C_PREV   &kp C_VOL_UP    &kp C_NEXT   ___         ,
//├─────────────┼─────────────┼─────────────┼─────────────┼─────────────┤ ├─────────────┼─────────────┼─────────────┼─────────────┼─────────────┤
   &hml LGUI F11 &hml LALT F4  &hml LCTRL F5 &hml LSHFT F6  ___         ,   &kp F14        DSK_PREV    &kp C_VOL_DN    DSK_NEXT     ___         ,
//├─────────────┼─────────────┼─────────────┼─────────────┼─────────────┤ ├─────────────┼─────────────┼─────────────┼─────────────┼─────────────┤
    &kp F10       &kp F1       &kp F2        &kp F3         ___         ,   &kp F13       ___           ___           ___           ___         ,
//╰─────────────┼─────────────┴─────────────┼─────────────┼─────────────┤ ├─────────────┼─────────────┼─────────────┴───────────────────────────╯
                                                   ___      &kp TAB     ,   &kp C_MUTE    &kp C_PP
//                                          ╰─────────────┴─────────────╯ ╰─────────────┴─────────────╯
)

ZMK_BASE_LAYER(Sys,
//╭─────────────┬─────────────┬─────────────┬─────────────┬─────────────╮ ╭─────────────┬─────────────┬─────────────┬─────────────┬─────────────╮
                               _BT_SEL_KEYS_                            ,    ___           ___           ___           ___           ___        ,
//├─────────────┼─────────────┼─────────────┼─────────────┼─────────────┤ ├─────────────┼─────────────┼─────────────┼─────────────┼─────────────┤
   ___           ___           ___           ___           &bootloader  ,    &bootloader   ___           ___           ___           ___        ,
//├─────────────┼─────────────┼─────────────┼─────────────┼─────────────┤ ├─────────────┼─────────────┼─────────────┼─────────────┼─────────────┤
   ___           ___           ___           ___           &sys_reset   ,    &sys_reset    ___           ___           ___           ___        ,
//╰─────────────┼─────────────┴─────────────┼─────────────┼─────────────┤ ├─────────────┼─────────────┼─────────────┴───────────────────────────╯
                                             ___           ___          ,    ___           ___                                                   
//                                          ╰─────────────┴─────────────╯ ╰─────────────┴─────────────╯                                          
)

ZMK_BASE_LAYER(Mouse,
//╭─────────────┬─────────────┬─────────────┬─────────────┬─────────────╮ ╭─────────────┬─────────────┬─────────────┬─────────────┬─────────────╮
    ___           ___           ___           ___           ___         ,   U_WH_U           U_WH_L      U_MS_U         U_WH_R       U_WH_U     ,
//├─────────────┼─────────────┼─────────────┼─────────────┼─────────────┤ ├─────────────┼─────────────┼─────────────┼─────────────┼─────────────┤
    &kp LGUI      &kp LALT      &kp LCTRL     &kp LSHFT     ___         ,   U_WH_D           U_MS_L      U_MS_D         U_MS_R       U_WH_D     ,
//├─────────────┼─────────────┼─────────────┼─────────────┼─────────────┤ ├─────────────┼─────────────┼─────────────┼─────────────┼─────────────┤
    ___           ___           ___           ___           ___         ,   GRID           &mkp LCLK     &mkp MCLK      &mkp RCLK    HINT       ,
//╰─────────────┼─────────────┴─────────────┼─────────────┼─────────────┤ ├─────────────┼─────────────┼─────────────┴───────────────────────────╯
                                              ___           ___         ,   &mkp LCLK      &mkp RCLK
//                                          ╰─────────────┴─────────────╯ ╰─────────────┴─────────────╯
)
/* vim: set ft=c tw=174: */
